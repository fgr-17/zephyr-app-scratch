## CMakeLists.txt
```
cmake_minimum_required(VERSION 3.20.0)

set(APP "zephyr_app_scratch")
set(CXX_STANDARD C++17)
find_package(Zephyr REQUIRED HINTS $ENV{ZEPHYR_BASE})

project(${APP})

target_sources(app PRIVATE src/main.cpp)
```

## west.yml
```
manifest:
  remotes:
    - name: zephyrproject
      url-base: https://github.com/zephyrproject-rtos
  defaults:
    remote: zephyrproject

  projects:
    # Zephyr repository (specific tag or branch)
    - name: zephyr
      path: zephyr
      revision: v3.7.0
      import: true  # Pull in Zephyr modules automatically
    - name: cmsis
      revision: 4b96cbb174678dcd3ca86e11e1f24bc5f8726da0
      path: modules/hal/cmsis
      groups:
        - hal
    - name: hal_nordic
      revision: dce8519f7da37b0a745237679fd3f88250b495ff
      path: modules/hal/nordic
      groups:
        - hal

  self:
    path: .
```

## prj.conf
```kconfig
# Enable GPIO functionality
CONFIG_GPIO=y

# Enable logging (optional, for debug purposes)
CONFIG_LOG=y
```

## src/main.c
```c
#include <zephyr/kernel.h>
#include <zephyr/device.h>
#include <zephyr/devicetree.h>
#include <zephyr/drivers/gpio.h>

#define LED0_NODE DT_ALIAS(led0)
#if !DT_NODE_HAS_STATUS(LED0_NODE, okay)
#error "Unsupported board: led0 device tree alias is not defined"
#endif

static const struct gpio_dt_spec led = GPIO_DT_SPEC_GET(LED0_NODE, gpios);

void main(void)
{
    if (!device_is_ready(led.port)) {
        return;
    }

    gpio_pin_configure_dt(&led, GPIO_OUTPUT);

    while (1) {
        gpio_pin_toggle_dt(&led);
        k_msleep(500);  // Blink every 500ms
    }
}
```

## src/main.cpp
```c
#include <zephyr/kernel.h>
#include <zephyr/device.h>
#include <zephyr/devicetree.h>
#include <zephyr/drivers/gpio.h>
#include <zephyr/logging/log.h>


#define LED0_NODE DT_ALIAS(led0)
#if !DT_NODE_HAS_STATUS(LED0_NODE, okay)
#error "Unsupported board: led0 device tree alias is not defined"
#endif

static const struct gpio_dt_spec led = GPIO_DT_SPEC_GET(LED0_NODE, gpios);

int main(void)
{
    printk("Zephyr from scratch example app - iomico zephyr course\n");
    printk("author: rouxfederico@gmail.com\n");

    printk("Board: %s\n", CONFIG_BOARD);

    if (!device_is_ready(led.port)) {
        printk("device is not ready\n");
        return 1;
    }

    gpio_pin_configure_dt(&led, GPIO_OUTPUT);

    while (1) {
        gpio_pin_toggle_dt(&led);
        k_msleep(500);  // Blink every 500ms
    }
    return 0;
}
```
